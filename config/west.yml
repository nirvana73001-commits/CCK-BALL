## config/west.yml
```yaml
manifest:
  remotes:
    - name: zmkfirmware
      url-base: https://github.com/zmkfirmware
    - name: kohei
      url-base: https://github.com/nirvana73001-commits   # ← あなたの GitHub アカウント名にする

  projects:
    - name: zmk
      remote: zmkfirmware
      revision: v0.3.0+fixes
      path: zmk

    - name: zmk-pmw3610-driver
      remote: kohei   # ← あなたの public fork にする
      revision: main

  self:
    path: config
```
